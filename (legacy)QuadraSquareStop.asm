PROCESSOR 16F876

; --- REGISTER FILES 선언 -------
; BANK 0
INDF EQU 00H
TMR0 EQU 01H
PCL EQU 02H
STATUS EQU 03H
FSR EQU 04H
PORTA EQU 05H
PORTB EQU 06H
PORTC EQU 07H
EEDATA EQU 08H
EEADR EQU 09H
PCLATH EQU 0AH
INTCON EQU 0BH
PIR1 EQU 0CH
PIR2 EQU 0DH
RCSTA EQU 18H
TXREG EQU 19H
; BANK 1
OPTIONR EQU 81H
TRISA EQU 85H
TRISB EQU 86H
TRISC EQU 87H
EECON1 EQU 88H
EECON2 EQU 89H
PIE1 EQU 8CH
PIE2 EQU 8DH
TXSTA EQU 98H
SPBRG EQU 99H
ADCON1 EQU 9FH


; --- STATUS BITS 선언 -----
IR EQU 7
RP1 EQU 6
RP0 EQU 5
NOT_TO EQU 4
NOT_PD EQU 3
ZF EQU 2 ; ZERO FLAG BIT
DC EQU 1 ; DIGIT CARRY/BORROW BIT
CF EQU 0 ; CARRY/BORROW FLAG BIT


; -- INTCON BITS 선언 -----

; -- OPTION BITS 선언 -----
W EQU B'0' ; W 변수를 0으로 선언
F EQU .1 ; F 변수를 1로 선언

; -- GPR 선언 --
; 확장 스테이터스 레지스터들
GP_STATUS EQU 24H
SWT_STATUS EQU 25H
SP_STATUS EQU 26H
MOD_STATUS EQU 27H

; 현재 랩 번호 저장
LAP_NUM EQU 28H

;인터럽트 백업
W_TEMP EQU 29H
S_TEMP EQU 2AH
;카운터
INT_CNT EQU 2BH
TMR_CNT EQU 2CH
SW_CNT EQU 2DH
;데이터 버퍼
SWT_BF EQU 2EH
MAIN_BF EQU 2FH
STACK_BF EQU 30H

;CLOCK
D_1SEC EQU 31H
D_10SEC EQU 32H
D_1MIN EQU 33H
D_10MIN EQU 34H
D_1HR EQU 35H
D_10HR EQU 36H
D_THR EQU 37H
BT_DELAY EQU 38H
B_BEEP EQU 39H
B_BEEP_CNT EQU 3AH
B_BEEP_EB EQU 3BH

;TIMER
T_1SEC EQU 61H
T_10SEC EQU 62H
T_1MIN EQU 63H
T_10MIN EQU 64H
T_1HR EQU 65H
T_10HR EQU 66H

;STOPWATCH
S_1SEC EQU 68H
S_10SEC EQU 69H
S_1MIN EQU 6AH
S_10MIN EQU 6BH



;DISP BUFFER
DISPBF_1 EQU 71H
DISPBF_2 EQU 72H
DISPBF_3 EQU 73H
DISPBF_4 EQU 74H

; -- GP-STATUS BIT 선언 --
;0-1 : 현재 전원을 넣을 7세그먼트 번호를 저장함
INT_SWT1 EQU 0
INT_SWT2 EQU 1
INT_SWT3 EQU 2
INT_SWT4 EQU 3
;4-7 : 몇번째 세그먼트의 도트가 켜지는지 저장함
DOT_SWT1 EQU 4
DOT_SWT2 EQU 5
DOT_SWT3 EQU 6
DOT_SWT4 EQU 7

; -- SWT-STATUS BIT 선언
;0 : 현재 보여줄것이 시/분인지 분/초인지
HM_CONV EQU 0
;1
BACK_CLOCK EQU 1
;2
BACK_TIMER EQU 2
;3 : 버튼 입력 가능한지 여부
BT_ENABLE EQU 3
;4 : 타이머 동작여부
TIMER_ON EQU 4
;5 : 스톱워치 동작여부
SW_ON EQU 5
;6 : LAP 존재여부
LAP_EXT EQU 6
;7 : LAP 가득참
LAP_OV EQU 7

; -- MOD-STATUS BIT 선언
;0 : 시계모드
MODE1 EQU 0
;1 : 타이머설정모드
MODE2 EQU 1
;2 : 타이머작동모드
MODE3 EQU 2
;3 : 스톱워치모드
MODE4 EQU 3
;4 : 부저 온오프 관리 (사용안함)
B_ENABLE EQU 4
;5 : 부저 박자 관리
B_BEEPALLOW EQU 5
;6 : 부저 박자 관리 2
B_BEEPTEMPO EQU 6
;7 : 부저 박자 관리 3
B_PRES EQU 7

; SP-STATUS BIT 선언
;0~4 : 타이머 카운터
DOT_CHECK1 EQU 0
DOT_CHECK2 EQU 1
DOT_SEC EQU 2
DOT_HALF EQU 3 ; (사용안함)
DOT_QUADRA EQU 4 ; (사용안함)
; 5 : 현재 랩확인모드인가?
LAP_CHECK EQU 5

; -- start
ORG 0
GOTO START_UP

; Interupt routine
ORG 4
	MOVWF W_TEMP ; W,S 백업
	SWAPF STATUS,W
	MOVWF S_TEMP
	CALL DISP ; DISPLAY 부 프로그램
BT_MOD ; 버튼 채터링 지연시간 관리	
	MOVF BT_DELAY,W
	BTFSC STATUS,ZF
	GOTO BEEP_MOD
	DECF BT_DELAY,F
BEEP_MOD ; 부저 소리 길이 관리
	MOVF B_BEEP,W
	BTFSC STATUS,ZF
	GOTO L_LOOP1
	DECF B_BEEP,F
L_LOOP1 ; 백업한걸 되돌림
	SWAPF S_TEMP,W
	MOVWF STATUS
	SWAPF W_TEMP,F
	SWAPF W_TEMP,W
	BCF INTCON,2
	RETFIE
DISP
	BTFSC GP_STATUS, INT_SWT1
	GOTO DISP1
	BTFSC GP_STATUS, INT_SWT2
	GOTO DISP2
	BTFSC GP_STATUS, INT_SWT3
	GOTO DISP3
	GOTO DISP4
;각각의 디스플레이를 구현
DISP1
	BSF PORTA,3
	MOVF DISPBF_1,W
	CALL D_CONV	
	MOVWF PORTC
	BTFSC GP_STATUS,DOT_SWT1
	BSF PORTC,0
	BCF PORTA,0
	BCF GP_STATUS,INT_SWT1
	BSF GP_STATUS,INT_SWT2
	INCF TMR_CNT,F
	RETURN
DISP2
	BSF PORTA,0
	MOVF DISPBF_2,W
	CALL D_CONV
	MOVWF PORTC
	BTFSC GP_STATUS,DOT_SWT2
	BSF PORTC,0
	BCF PORTA,1
	BCF GP_STATUS,INT_SWT2
	BSF GP_STATUS,INT_SWT3
	INCF SW_CNT,F
	RETURN
DISP3
	BSF PORTA,1
	MOVF DISPBF_3,W
	CALL D_CONV
	MOVWF PORTC
	BTFSC GP_STATUS,DOT_SWT3
	BSF PORTC,0
	BCF PORTA,2
	BCF GP_STATUS,INT_SWT3
	BSF GP_STATUS,INT_SWT4
	RETURN
DISP4
	BSF PORTA,2
	MOVF DISPBF_4,W
	CALL D_CONV
	MOVWF PORTC
	BTFSC GP_STATUS,DOT_SWT4
	BSF PORTC,0
	BCF PORTA,3
	BCF GP_STATUS,INT_SWT4
	BSF GP_STATUS,INT_SWT1
	INCF INT_CNT,F
	RETURN

D_CONV
	ANDLW 0FH
	ADDWF PCL,F
	RETLW B'11111100' ; 0
	RETLW B'01100000' ; 1
	RETLW B'11011010' ; 2
	RETLW B'11110010' ; 3
	RETLW B'01100110' ; 4
	RETLW B'10110110' ; 5
	RETLW B'10111110' ; 6
	RETLW B'11100100' ; 7
	RETLW B'11111110' ; 8
	RETLW B'11110110' ; 9
	RETLW B'00000010' ; -
	RETLW B'00000000' ; 
	RETLW B'00011010' ; c
	RETLW B'00000001' ; .
	RETLW B'10011110' ; E
	RETLW B'10001110' ; F
	
;--main
START_UP
	CLRF STATUS
	BSF STATUS,RP0 ; RAM BANK 1 선택
	MOVLW B'00000000' ; PORT I/O 선택
	MOVWF TRISA
	MOVLW B'00001111' ; PORT I/O 선택
	MOVWF TRISB
	MOVLW B'00000000' ; PORT I/O 선택
	MOVWF TRISC
	MOVLW B'00000001' ; 1.024msec (1:4)
	MOVWF OPTIONR
	BCF STATUS,RP0 ; RAM BANK 0 선택
	BSF INTCON,5 ; TIMER INTERRUPT ENABLE
	BSF INTCON,7 ; GLOBAL INT. ENABLE
DEFAULT_ST ; 초기설정 초기화
DEFAULT_MOD
	MOVLW B'00000001'
	MOVWF MOD_STATUS
	CLRF SWT_STATUS
	BCF SWT_STATUS, HM_CONV
	CLRF GP_STATUS
	CLRF BT_DELAY
	CLRF B_BEEP
	CLRF SP_STATUS
	MOVLW B'00001111'
	MOVWF PORTA ; 커먼 캐소드 방식이므로 초기화 필요
	CALL DEFAULT_CLOCK
	CALL DEFAULT_TMR
	CALL DEFAULT_SW
	GOTO M_LOOP
DEFAULT_CLOCK	
	CLRF D_1SEC
	CLRF D_10SEC
	CLRF D_1MIN
	CLRF D_10MIN
	CLRF D_1HR
	CLRF D_10HR
	CLRF D_THR
	CLRF INT_CNT
	RETURN
DEFAULT_TMR
	CLRF T_1SEC
	CLRF T_10SEC
	CLRF T_1MIN
	CLRF T_10MIN
	CLRF T_1HR
	CLRF T_10HR
	CLRF TMR_CNT
	RETURN
DEFAULT_SW	
	CLRF S_1SEC
	CLRF S_10SEC
	CLRF S_1MIN
	CLRF S_10MIN
	CLRF SW_CNT
	CLRF LAP_NUM
	MOVLW 40H
	MOVWF FSR
	RETURN

M_LOOP
TM_LPS ;타이머 확인
	BTFSC SWT_STATUS, TIMER_ON
	GOTO TM_LP ; 타이머 작동모드
	GOTO SW_LPS
TM_LP ; 타이머 작동모드
	MOVLW .244
	SUBWF TMR_CNT,W
	BTFSS STATUS,ZF
	GOTO SW_LPS
	CLRF TMR_CNT
TM_START ; 타이머는 시계와 달리 반대로 동작하므로 DECF와 ZF를 사용해 구현한다.
	MOVF T_1SEC,W
	BTFSC STATUS,ZF
	GOTO TM_1_ZF
	DECF T_1SEC
	GOTO TM_LPE
TM_1_ZF
	MOVF T_10SEC,W
	BTFSC STATUS,ZF
	GOTO TM_10_ZF
	DECF T_10SEC
	MOVLW .10
	MOVWF T_1SEC
	GOTO TM_START ; 반대로 동작하므로 내림을 받고 처음부터 다시 루프를 돌려야한다.
TM_10_ZF
	MOVF T_1MIN,W
	BTFSC STATUS,ZF
	GOTO TM_1M_ZF
	DECF T_1MIN
	MOVLW .6
	MOVWF T_10SEC
	GOTO TM_START
TM_1M_ZF
	MOVF T_10MIN,W
	BTFSC STATUS,ZF
	GOTO TM_10M_ZF
	DECF T_10MIN
	MOVLW .10
	MOVWF T_1MIN
	GOTO TM_START
TM_10M_ZF
	MOVF T_1HR,W
	BTFSC STATUS,ZF
	GOTO TM_1H_ZF
	DECF T_1HR
	MOVLW .6
	MOVWF T_10MIN
	GOTO TM_START
TM_1H_ZF
	MOVF T_10HR,W
	BTFSC STATUS,ZF
	GOTO TM_10H_ZF
	DECF T_10HR
	MOVLW .10
	MOVWF T_1HR
	GOTO TM_START
TM_10H_ZF
	CALL BEEP_4 ; 모든 자리가 0이 될때 타이머가 끝난다는것을 알려준다.
	BCF SWT_STATUS, TIMER_ON
	BTFSS MOD_STATUS, MODE3
	GOTO TM_LPE
	BCF MOD_STATUS, MODE2
	GOTO TM_LPE
TM_LPE

SW_LPS ;스톱워치 확인
	BTFSC SWT_STATUS, SW_ON
	GOTO SW_LP
	CLRF SW_CNT
	GOTO CK_LPS
SW_LP
	MOVLW .244
	SUBWF SW_CNT,W
	BTFSS STATUS,ZF
	GOTO SW_LPE
	GOTO SW_LOOP
SW_LOOP
	CLRF SW_CNT ; 다음 1초를 기다리기 위한 초기화 SW_CNT=0
	INCF S_1SEC 
	MOVLW .10
	SUBWF S_1SEC,W
	BTFSS STATUS,ZF
	GOTO XLOOP
	CLRF S_1SEC
	INCF S_10SEC
	MOVLW .6
	SUBWF D_10SEC,W
	BTFSS STATUS,ZF
	GOTO XLOOP
	CLRF S_10SEC
	INCF S_1MIN
	MOVLW .10
	SUBWF D_1MIN,W
	BTFSS STATUS,ZF
	GOTO XLOOP
	CLRF D_1MIN
	INCF D_10MIN
	MOVLW .10
	SUBWF D_10MIN,W
	BTFSS STATUS,ZF
	GOTO SW_LPE
	CALL BEEP_3
	GOTO SW_LPE
SW_LPE

CK_LPS ;시계는 무조건 작동해야한다.
	MOVLW .61
	SUBWF INT_CNT,W
	BTFSS STATUS,ZF
	GOTO XLOOP
	GOTO DOT_LOOP
DOT_LOOP ; 1초를 4개로 나눠서 0.25초 단위로 동작하도록 한다.
	CLRF INT_CNT
	MOVF SP_STATUS,W
	ANDLW B'00000011'
	MOVWF MAIN_BF
	MOVLW .3
	SUBWF MAIN_BF,W
	BTFSC STATUS,ZF	
	GOTO CK_LOOP_S
	INCF SP_STATUS,F
	GOTO XLOOP
CK_LOOP_S
	BCF SP_STATUS, DOT_CHECK2
	BCF SP_STATUS, DOT_CHECK1
	BTFSS SP_STATUS, DOT_SEC
	GOTO CK_LOOP_S2
	BCF SP_STATUS,DOT_SEC
	GOTO CK_LOOP
CK_LOOP_S2
	BSF SP_STATUS,DOT_SEC ; 1초단위의 클록이 필요한 기능이 없으므로 실제로는 필요없는 부분.
	GOTO CK_LOOP
CK_LOOP
	INCF D_1SEC
	MOVLW .10
	SUBWF D_1SEC,W
	BTFSS STATUS,ZF
	GOTO XLOOP
	CLRF D_1SEC
	INCF D_10SEC
	MOVLW .6
	SUBWF D_10SEC,W
	BTFSS STATUS,ZF
	GOTO XLOOP
	CLRF D_10SEC
	INCF D_1MIN
	MOVLW .10
	SUBWF D_1MIN,W
	BTFSS STATUS,ZF
	GOTO XLOOP
	CLRF D_1MIN
	INCF D_10MIN
	MOVLW .6
	SUBWF D_10MIN,W
	BTFSS STATUS,ZF
	GOTO XLOOP
	CLRF D_10MIN
	INCF D_1HR
	INCF D_THR
	MOVLW .10
	SUBWF D_1HR,W
	BTFSS STATUS,ZF
	GOTO CK_LOOP_2
	CLRF D_1HR
	INCF D_10HR
	GOTO XLOOP
CK_LOOP_2
	MOVLW .24 ; 시계는 24시간이 최대이므로 24시간을 체크하는 변수를 따로 둔다.
	SUBWF D_THR,W
	BTFSS STATUS,ZF
	GOTO XLOOP
	CLRF D_THR
	CLRF D_1HR
	CLRF D_10HR
	GOTO XLOOP
XLOOP
; 모드에 따라 FND에 들어가야하는 데이터가 다르므로 그것을 분류해주는 루프
; 타이머는 백그라운드에서도 작동하고, 랩 체크는 한 모드안에서도 켜지고 꺼지는 경우가 다르므로 따로 체크한다.
DOT_1_SP
	BTFSS SWT_STATUS, TIMER_ON
	GOTO DOT_1_OFF
	BSF GP_STATUS, DOT_SWT1
	GOTO DOT_2_SP
DOT_1_OFF
	BCF GP_STATUS, DOT_SWT1
DOT_2_SP
	BTFSC MOD_STATUS, MODE2
	GOTO DOT_3_SP
	BTFSC SP_STATUS, LAP_CHECK
	GOTO DOT_3_SP
	BCF GP_STATUS, DOT_SWT2
DOT_3_SP
	BTFSC MOD_STATUS, MODE3
	GOTO DOT_4_SP
	BCF GP_STATUS, DOT_SWT3
DOT_4_SP
XLOOP_START ; 현재 모드별로 분기
	BTFSC MOD_STATUS, MODE1
	GOTO MODE1_XLOOP
	BTFSC MOD_STATUS, MODE2
	GOTO MODE2_XLOOP_START
	BTFSC MOD_STATUS, MODE3
	GOTO MODE2_XLOOP
	BTFSC MOD_STATUS, MODE4
	GOTO MODE4_XLOOP
	GOTO BT_LOOP
MODE1_XLOOP
	BCF GP_STATUS, DOT_SWT2
	BCF GP_STATUS, DOT_SWT3
	BTFSS SWT_STATUS, HM_CONV ; 시/분 , 분/초 별로 분기
	GOTO MODE1_1_XLOOP
	GOTO MODE1_2_XLOOP
MODE1_1_XLOOP
	BSF GP_STATUS, DOT_SWT4
	MOVF D_1MIN,W
	MOVWF DISPBF_1
	MOVF D_10MIN,W
	MOVWF DISPBF_2
	MOVF D_1HR,W
	MOVWF DISPBF_3
	MOVF D_10HR,W
	MOVWF DISPBF_4
	GOTO BT_LOOP
MODE1_2_XLOOP
	BCF GP_STATUS, DOT_SWT4
	MOVF D_1SEC,W
	MOVWF DISPBF_1
	MOVF D_10SEC,W
	MOVWF DISPBF_2
	MOVF D_1MIN,W
	MOVWF DISPBF_3
	MOVF D_10MIN,W
	MOVWF DISPBF_4
	GOTO BT_LOOP
MODE2_XLOOP_START
	BSF GP_STATUS, DOT_SWT2
	GOTO MODE2_XLOOP
MODE2_XLOOP
	BTFSS SWT_STATUS, HM_CONV
	GOTO MODE2_1_XLOOP
	GOTO MODE2_2_XLOOP
MODE2_1_XLOOP
	BSF GP_STATUS, DOT_SWT4
	MOVF T_1MIN,W
	MOVWF DISPBF_1
	MOVF T_10MIN,W
	MOVWF DISPBF_2
	MOVF T_1HR,W
	MOVWF DISPBF_3
	MOVF T_10HR,W
	MOVWF DISPBF_4
	GOTO BT_LOOP
MODE2_2_XLOOP
	BCF GP_STATUS, DOT_SWT4
	MOVF T_1SEC,W
	MOVWF DISPBF_1
	MOVF T_10SEC,W
	MOVWF DISPBF_2
	MOVF T_1MIN,W
	MOVWF DISPBF_3
	MOVF T_10MIN,W
	MOVWF DISPBF_4
	GOTO BT_LOOP
MODE4_XLOOP
	BTFSS SWT_STATUS,SW_ON
	GOTO DOT_3_ON_BLINK
	GOTO DOT_3_ON
DOT_3_ON_BLINK ; 스톱워치가 정지된 상황이라면 깜빡이도록 한다. 0.25초 간격으로 토글되도록 카운터를 사용한다.
	BTFSC SP_STATUS, DOT_CHECK1
	GOTO DOT_3_OFF
	GOTO DOT_3_ON 
DOT_3_OFF
	BCF GP_STATUS, DOT_SWT3
	GOTO MODE4_XLOOP_2
DOT_3_ON
	BSF GP_STATUS, DOT_SWT3
	GOTO MODE4_XLOOP_2
MODE4_XLOOP_2
	BTFSS SWT_STATUS, LAP_EXT
	GOTO DOT_4_OFF
	BTFSS SWT_STATUS, LAP_OV
	GOTO DOT_4_ON
	GOTO DOT_4_ON_BLINK
DOT_4_ON_BLINK ; 랩이 가득찼다면 0.25초 간격으로 토글되도록 카운터를 사용한다.
	BTFSC SP_STATUS, DOT_CHECK1
	GOTO DOT_4_OFF
	GOTO DOT_4_ON 
DOT_4_OFF	
	BCF GP_STATUS, DOT_SWT4
	GOTO MODE4_XLOOP_BCD
DOT_4_ON
	BSF GP_STATUS, DOT_SWT4
	GOTO MODE4_XLOOP_BCD
MODE4_XLOOP_BCD
	BTFSC SP_STATUS, LAP_CHECK
	BSF GP_STATUS, DOT_SWT2
	MOVF S_1SEC,W
	MOVWF DISPBF_1
	MOVF S_10SEC,W
	MOVWF DISPBF_2
	MOVF S_1MIN,W
	MOVWF DISPBF_3
	MOVF S_10MIN,W
	MOVWF DISPBF_4
	GOTO BT_LOOP
BT_LOOP
; 버튼 입력의 순서는 다음과 같다.
; 1. 채터링 지연시간이 흘렀는가? -> 아직이라면 버튼입력을 무시한다.
; 2. 버튼에서 손을 때었는가? -> 손을 땔 때 까지 추가적인 버튼입력을 무시한다.
; 3. 무슨 버튼을 눌렀는가? -> 버튼에 따라 분기.
	MOVF BT_DELAY,W
	BTFSS STATUS,ZF
	GOTO L_LOOP
	BTFSC SWT_STATUS,BT_ENABLE
	GOTO BT_LOOP1
BT_CHECK ; 버튼을 손에서 때었는지를 확인하는 루프
	MOVF PORTB,W
	ANDLW B'00001111'
	XORLW B'00001111' ; 버튼을 부르면 0이 입력되므로 가공절차가 필요하다.
	BTFSS STATUS,ZF
	GOTO L_LOOP
	BSF SWT_STATUS,BT_ENABLE	
BT_LOOP1
	BTFSC PORTB,0
	GOTO BT_LOOP2
	BCF SWT_STATUS,BT_ENABLE
	CALL BEEP_2
	MOVLW 7FH
	MOVWF BT_DELAY
	CALL BT_1
	GOTO L_LOOP
BT_LOOP2
	BTFSC PORTB,1
	GOTO BT_LOOP3
	BCF SWT_STATUS,BT_ENABLE
	CALL BEEP_2
	MOVLW 7FH
	MOVWF BT_DELAY
	CALL BT_2
	GOTO L_LOOP
BT_LOOP3
	BTFSC PORTB,2
	GOTO BT_LOOP4
	BCF SWT_STATUS,BT_ENABLE
	CALL BEEP_2
	MOVLW 7FH
	MOVWF BT_DELAY
	CALL BT_3
	GOTO L_LOOP
BT_LOOP4
	BTFSC PORTB,3
	GOTO L_LOOP
	BCF SWT_STATUS,BT_ENABLE
	CALL BEEP_2
	MOVLW 7FH
	MOVWF BT_DELAY
	CALL BT_4
	GOTO L_LOOP
L_LOOP
; 루프의 마지막에는 부저를 관리한다.
	CALL BUZZ_BEEP_MOD
	CALL BUZZ_CTR
	GOTO M_LOOP	

;######################
; 버튼 입력 서브루틴
; 각각의 모드와 눌러진 버튼을 확인해
; 버튼 입력후의 업무를 시행한다.
;######################
; BT_4
; 시계 : FND 4~3 자리의 수치를 증가시킨다.
; 타이머 설정 : 시계와 동일
; 타이머 동작 : 설정으로 돌아간다
; 스톱워치 : 랩을 등록한다. 랩 확인중에는 다음 랩을 확인한다.
;######################
BT_4
	BTFSC MOD_STATUS, MODE1
	GOTO BT_4_1
	BTFSC MOD_STATUS, MODE2
	GOTO BT_4_2
	BTFSC MOD_STATUS, MODE3
	GOTO BT_4_3
	BTFSC MOD_STATUS, MODE4
	GOTO BT_4_4
	GOTO L_LOOP
BT_4_1
	BTFSS SWT_STATUS, HM_CONV
	GOTO C_INCF_HR
	GOTO C_INCF_MIN
BT_4_2
	BTFSS SWT_STATUS, HM_CONV
	GOTO T_INCF_HR
	GOTO T_INCF_MIN
BT_4_3
	BCF SWT_STATUS,TIMER_ON
	BCF MOD_STATUS,MODE3
	BSF MOD_STATUS,MODE2
	RETURN
BT_4_4
	BTFSS SP_STATUS, LAP_CHECK
	GOTO LAP_PLUS
	GOTO CHECK_NEXTLAP
LAP_PLUS
	BTFSC SWT_STATUS, LAP_OV
	GOTO LAP_PLUS_OVER
	BSF SWT_STATUS,LAP_EXT
	INCF LAP_NUM
	CALL LAP_REG
	BTFSC LAP_NUM,4
	BSF SWT_STATUS, LAP_OV
	RETURN
LAP_PLUS_OVER
	CALL BEEP_2
	RETURN
CHECK_NEXTLAP
	MOVF LAP_NUM,W
	BTFSC STATUS,ZF
	GOTO LAP_ENDED
	BCF SWT_STATUS, LAP_OV
	DECF LAP_NUM
	CALL LAP_POP
	MOVF LAP_NUM,W
	BTFSC STATUS,ZF
	GOTO LAP_LAST
	RETURN
LAP_LAST
	BCF SWT_STATUS,LAP_EXT
	RETURN
LAP_ENDED
	CLRF S_1SEC
	CLRF S_10SEC
	CLRF S_1MIN
	CLRF S_10MIN
	CLRF SW_CNT
	BCF SP_STATUS, LAP_CHECK 
	RETURN
;######################
; BT_3
; 시계 : FND 2~1 자리의 수치를 증가시킨다.
; 타이머 설정 : 시계와 동일
; 타이머 동작 : 타이머를 초기화하고 설정으로 돌아간다.
; 스톱워치 : 랩 확인모드로 들어간다. 이미 확인모드 일 경우 스톱워치를 리셋한다.
;######################
BT_3
	BTFSC MOD_STATUS, MODE1
	GOTO BT_3_1
	BTFSC MOD_STATUS, MODE2
	GOTO BT_3_2
	BTFSC MOD_STATUS, MODE3
	GOTO BT_3_3
	BTFSC MOD_STATUS, MODE4
	GOTO BT_3_4
	GOTO L_LOOP
BT_3_1
	BTFSS SWT_STATUS, HM_CONV
	GOTO C_INCF_MIN
	GOTO C_INCF_SEC
BT_3_2
	BTFSS SWT_STATUS, HM_CONV
	GOTO T_INCF_MIN
	GOTO T_INCF_SEC
BT_3_3
	BCF SWT_STATUS,TIMER_ON
	CLRF T_1SEC
	CLRF T_10SEC
	CLRF T_1MIN
	CLRF T_10MIN
	CLRF T_1HR
	CLRF T_10HR
	CLRF TMR_CNT
	BCF MOD_STATUS,MODE3
	BSF MOD_STATUS,MODE2
	RETURN
BT_3_4
	BTFSS SP_STATUS, LAP_CHECK
	GOTO CHECK_ON
	GOTO SW_RESET
CHECK_ON
	BSF SP_STATUS,LAP_CHECK
	BCF SWT_STATUS, SW_ON
	RETURN
SW_RESET
	CLRF S_1SEC
	CLRF S_10SEC
	CLRF S_1MIN
	CLRF S_10MIN
	CLRF SW_CNT
	BCF SP_STATUS, LAP_CHECK 
	MOVLW 40H
	MOVWF FSR
	CLRF LAP_NUM
	BCF SWT_STATUS, LAP_EXT
	BCF SWT_STATUS, LAP_OV
	RETURN
	
;######################
; BT_2
; 시계 : 시/분 모드와 분/초 모드를 토글한다.
; 타이머 설정 : 시계와 동일
; 타이머 동작 : 시계와 동일
; 스톱워치 : 시작/일시정지. 랩 확인모드에는 불가능
;######################
BT_2
	BTFSC MOD_STATUS, MODE1
	GOTO BT_2_1
	BTFSC MOD_STATUS, MODE2
	GOTO BT_2_1
	BTFSC MOD_STATUS, MODE3
	GOTO BT_2_1
	BTFSC MOD_STATUS, MODE4
	GOTO BT_2_4
	GOTO L_LOOP
BT_2_1
	BTFSS SWT_STATUS, HM_CONV
	GOTO HM_CONV_SET
	BCF SWT_STATUS,HM_CONV
	RETURN
HM_CONV_SET
	BSF SWT_STATUS,HM_CONV
	RETURN
BT_2_4
	BTFSS SP_STATUS, LAP_CHECK
	GOTO SW_LATCH
	RETURN
SW_LATCH
	BTFSS SWT_STATUS, SW_ON
	GOTO SW_LATCH_SET
	BCF SWT_STATUS,SW_ON
	RETURN
SW_LATCH_SET
	BSF SWT_STATUS,SW_ON
	RETURN
	
;######################
; BT_1
; 모드를 변경한다.
; 시계 - 타이머설정 - 타이머동작 - 스톱워치 순으로 변경된다.
; 이미 타이머가 동작중이라면 시계에서 바로 타이머동작으로 간다.
; 타이머설정중에 시간을 0초로 해 둘 경우 바로 스톱워치로 간다.
;######################
BT_1
	BTFSC MOD_STATUS, MODE1
	GOTO MODCONV1
	BTFSC MOD_STATUS, MODE2
	GOTO MODCONV2
	BTFSC MOD_STATUS, MODE3
	GOTO MODCONV3
	GOTO MODCONV4
	RETURN

C_INCF_HR
	INCF D_1HR ; 10초 단위 변수 증가
	INCF D_THR
	MOVLW .10 ; 수정하면 표시숫자 범위 수정가능
	SUBWF D_1HR,W
	BTFSS STATUS,ZF
	GOTO C_INCF_HR_2
	CLRF D_1HR
	INCF D_10HR ; 10초 단위 변수 증가
C_INCF_HR_2
	MOVLW .24 ; 수정하면 표시숫자 범위 수정가능
	SUBWF D_THR,W
	BTFSS STATUS,ZF
	RETURN
	CLRF D_THR
	CLRF D_10HR
	CLRF D_1HR
	RETURN
C_INCF_MIN
	INCF D_1MIN ; 10초 단위 변수 증가
	MOVLW .10 ; 수정하면 표시숫자 범위 수정가능
	SUBWF D_1MIN,W
	BTFSS STATUS,ZF
	RETURN
	;10분마다
	CLRF D_1MIN
	INCF D_10MIN ; 10초 단위 변수 증가
	MOVLW .6 ; 수정하면 표시숫자 범위 수정가능
	SUBWF D_10MIN,W
	BTFSS STATUS,ZF
	RETURN
	CLRF D_10MIN
	RETURN
C_INCF_SEC
	CLRF D_1SEC
	CLRF D_10SEC
	RETURN
	
T_INCF_HR
	INCF T_1HR ; 10초 단위 변수 증가
	MOVLW .10 ; 수정하면 표시숫자 범위 수정가능
	SUBWF T_1HR,W
	BTFSS STATUS,ZF
	RETURN
	;10분마다
	CLRF T_1HR
	INCF T_10HR ; 10초 단위 변수 증가
	MOVLW .3 ; 수정하면 표시숫자 범위 수정가능
	SUBWF T_10HR,W
	BTFSS STATUS,ZF
	RETURN
	CLRF T_10HR
	RETURN
T_INCF_MIN
	INCF T_1MIN ; 10초 단위 변수 증가
	MOVLW .10 ; 수정하면 표시숫자 범위 수정가능
	SUBWF T_1MIN,W
	BTFSS STATUS,ZF
	RETURN
	;10분마다
	CLRF T_1MIN
	INCF T_10MIN ; 10초 단위 변수 증가
	MOVLW .6 ; 수정하면 표시숫자 범위 수정가능
	SUBWF T_10MIN,W
	BTFSS STATUS,ZF
	RETURN
	CLRF T_10MIN
	RETURN
T_INCF_SEC
	INCF T_1SEC ; 10초 단위 변수 증가
	MOVLW .10 ; 수정하면 표시숫자 범위 수정가능
	SUBWF T_1SEC,W
	BTFSS STATUS,ZF
	RETURN
	;10분마다
	CLRF T_1SEC
	INCF T_10SEC ; 10초 단위 변수 증가
	MOVLW .6 ; 수정하면 표시숫자 범위 수정가능
	SUBWF T_10SEC,W
	BTFSS STATUS,ZF
	RETURN
	CLRF T_10SEC
	RETURN

;######################
;STACK구조
;######################
;RST_FSR
; FSR을 초기화한다.
;######################
RST_FSR
	MOVLW 40H
	MOVWF FSR
	RETURN

;######################
;PUSH_STACK / POP_STACK
; 값을 넣고 FSR을 늘린다.
; FSR을 줄이고 값을 뺀다.
;######################
PUSH_STACK
	MOVWF INDF
	INCF FSR,F
	RETURN

POP_STACK
	DECF FSR,F
	MOVF INDF,W
	CLRF INDF
	RETURN
	
;######################
;LAP_REG
; 2번의 PUSH로 이루어진다.
; 10초 - 1초 / 10분 - 1분 순서로 PUSH한다.
;######################
LAP_REG
	SWAPF S_10SEC,W
	MOVWF STACK_BF
	MOVF S_1SEC,W
	ADDWF STACK_BF
	MOVF STACK_BF,W
	CALL PUSH_STACK
	SWAPF S_10MIN,W
	MOVWF STACK_BF
	MOVF S_1MIN,W
	ADDWF STACK_BF
	MOVF STACK_BF,W
	CALL PUSH_STACK
	RETURN

;######################
;LAP_POP
; 2번의 POP으로 이루어진다.
; 1분 - 10분 / 1초 - 10초 순서로 POP한다.
;######################
LAP_POP
	CALL POP_STACK
	MOVWF STACK_BF
	ANDLW 0FH
	MOVWF S_1MIN
	SWAPF STACK_BF,W
	ANDLW 0FH
	MOVWF S_10MIN
	CALL POP_STACK
	MOVWF STACK_BF
	ANDLW 0FH
	MOVWF S_1SEC
	SWAPF STACK_BF,W
	ANDLW 0FH
	MOVWF S_10SEC
	RETURN
	
;######################
;모드 변경을 관장하는 부분. 버튼 주석에 설명이 됨
;######################
MODCONV1
	BCF MOD_STATUS,MODE1
	BTFSC SWT_STATUS,TIMER_ON
	GOTO TIMER_DIRECT_GO
	BSF MOD_STATUS,MODE2
	BSF SWT_STATUS,HM_CONV
	RETURN
TIMER_DIRECT_GO ; 타이머 실행중일 경우 설정을 생략
	CALL HM_SWITCH11
	CALL HM_SWITCH22
	BSF MOD_STATUS,MODE3
	RETURN
MODCONV2
	CALL TIMER_CHECK
	BCF MOD_STATUS,MODE2
	BTFSS SWT_STATUS,TIMER_ON
	GOTO SW_DIRECT_GO	
	BSF MOD_STATUS,MODE3
	RETURN
SW_DIRECT_GO ; 설정 안하면 실행을 생략
	BSF MOD_STATUS,MODE4
	RETURN
MODCONV3
	CALL HM_SWITCH12
	BCF MOD_STATUS,MODE3
	BSF MOD_STATUS,MODE4
	CLRF LAP_NUM
	RETURN
MODCONV4
	BCF MOD_STATUS,MODE4
	BSF MOD_STATUS,MODE1
	CALL HM_SWITCH21
	CLRF LAP_NUM
	BCF SWT_STATUS, SW_ON
	BCF SWT_STATUS, LAP_EXT
	BCF SWT_STATUS, LAP_OV
	BCF SP_STATUS, LAP_CHECK
	RETURN

;######################
;타이머와 시계의 시/분 모드 토글을 기억하고 대입하는 부분
;######################
HM_SWITCH11
	BTFSS SWT_STATUS, HM_CONV
	GOTO HS11
	BSF SWT_STATUS,BACK_CLOCK
	RETURN
HS11
	BCF SWT_STATUS,BACK_CLOCK
	RETURN
	
HM_SWITCH12
	BTFSS SWT_STATUS, HM_CONV
	GOTO HS22
	BSF SWT_STATUS,BACK_TIMER
	RETURN
HS12
	BCF SWT_STATUS,BACK_TIMER
	RETURN

HM_SWITCH21
	BTFSS SWT_STATUS, BACK_CLOCK
	GOTO HS11
	BSF SWT_STATUS,HM_CONV
	RETURN
HS21
	BCF SWT_STATUS,HM_CONV
	RETURN
	
HM_SWITCH22
	BTFSS SWT_STATUS, BACK_TIMER
	GOTO HS22
	BSF SWT_STATUS,HM_CONV
	RETURN
HS22
	BCF SWT_STATUS,HM_CONV
	RETURN
	
;######################
;타이머 설정이 되어있는지 체크
;######################
TIMER_CHECK
	MOVF T_1SEC,W
	BTFSS STATUS,ZF
	GOTO TIMER_CK_ENABLE
	MOVF T_10SEC,W
	BTFSS STATUS,ZF
	GOTO TIMER_CK_ENABLE
	MOVF T_1MIN,W
	BTFSS STATUS,ZF
	GOTO TIMER_CK_ENABLE
	MOVF T_10MIN,W
	BTFSS STATUS,ZF
	GOTO TIMER_CK_ENABLE
	MOVF T_1HR,W
	BTFSS STATUS,ZF
	GOTO TIMER_CK_ENABLE
	MOVF T_10HR,W
	BTFSS STATUS,ZF
	GOTO TIMER_CK_ENABLE
	BCF SWT_STATUS, TIMER_ON
	RETURN
TIMER_CK_ENABLE
	BSF SWT_STATUS, TIMER_ON
	RETURN

;######################
;부저신호를 관리하는 부분
;B_BEEP이 1이상이고 B_BEEPALLOW, B_BEEPTEMPO가 0일때 소리가 난다.
;######################
BUZZ_CTR
	MOVF B_BEEP,W
	BTFSC STATUS,ZF	
	GOTO BUZZ_OFF
	BTFSC MOD_STATUS,B_BEEPALLOW
	GOTO BUZZ_OFF
	BTFSC MOD_STATUS,B_BEEPTEMPO
	GOTO BUZZ_OFF
BUZZ_ON
	BSF PORTA,4
	RETURN
BUZZ_OFF
	BCF PORTA,4
	RETURN

;######################	
;B_BEEP이 0이 된다
; - B_BEEP_CNT 를 1 줄이고 B_BEEP를 122로 둔다.
; - B_PRES가 1이라면 대신 61을 준다.
;B_BEEP_CNT가 0이 된다
; - B_BEEP_EB 를 1 줄이고 B_BEEP_CNT를 8을 준다.
;B_BEEP_EB가 줄어들때마다 B_BEEPTEMPO 토글
;B_BEEP_CNT가 줄어들때마다 B_BEEPALLOW 토글
;######################
BUZZ_BEEP_MOD
	MOVF B_BEEP
	BTFSS STATUS, ZF
	RETURN
	MOVF B_BEEP_CNT
	BTFSS STATUS,ZF
	GOTO BEEP_MAIN
BEEP_SWT2
	MOVF B_BEEP_EB
	BTFSC STATUS,ZF
	RETURN
	DECF B_BEEP_EB
	MOVLW .8
	MOVWF B_BEEP_CNT
	BCF MOD_STATUS,B_BEEPALLOW
	BTFSC MOD_STATUS,B_BEEPTEMPO
	GOTO CLEAR_BEEPTEM
	BSF MOD_STATUS,B_BEEPTEMPO
	GOTO BEEP_MAIN
CLEAR_BEEPTEM
	BCF MOD_STATUS,B_BEEPTEMPO
	GOTO BEEP_MAIN
BEEP_MAIN
	DECF B_BEEP_CNT
	BTFSC MOD_STATUS,B_PRES
	GOTO BEEP_MAIN1
	MOVLW .122
	GOTO BEEP_MAIN2
BEEP_MAIN1
	MOVLW .61
BEEP_MAIN2
	MOVWF B_BEEP
	BTFSC MOD_STATUS,B_BEEPALLOW
	GOTO CLEAR_BEEP
	BSF MOD_STATUS,B_BEEPALLOW
	RETURN
CLEAR_BEEP
	BCF MOD_STATUS,B_BEEPALLOW
	RETURN
BEEP_1 ; 0.5초 삐
	CLRF B_BEEP_CNT
	CLRF B_BEEP_EB
	MOVLW .244
	MOVWF B_BEEP
	BCF MOD_STATUS,B_BEEPALLOW
	BCF MOD_STATUS,B_BEEPTEMPO
	RETURN
BEEP_2 ; 삑
	CLRF B_BEEP_CNT
	CLRF B_BEEP_EB
	MOVLW .15
	MOVWF B_BEEP
	BCF MOD_STATUS,B_BEEPALLOW
	BCF MOD_STATUS,B_BEEPTEMPO
	RETURN
BEEP_3 ; 삐-삐-!
	CLRF B_BEEP
	CLRF B_BEEP_EB
	MOVLW .4
	MOVWF B_BEEP_CNT
	BCF MOD_STATUS,B_BEEPALLOW
	BCF MOD_STATUS,B_BEEPTEMPO
	BCF MOD_STATUS,B_PRES
	RETURN
BEEP_4 ; 삐비비빅! * 4
	CLRF B_BEEP
	CLRF B_BEEP_CNT
	MOVLW .8
	MOVWF B_BEEP_EB
	BSF MOD_STATUS,B_BEEPALLOW
	BSF MOD_STATUS,B_BEEPTEMPO
	BSF MOD_STATUS,B_PRES
	RETURN
END